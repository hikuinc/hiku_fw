## hiku_gen3/marvell/wmsdk_bundle-3.3.33/sdk/src/middleware/httpc/Kconfig
```kconfig
menu "HTTP Client"

config MAX_REQ_RESP_HDR_SIZE
       prompt "Max supported request/response HTTP header size"
       int
       range 512 512000
       default 2048
       help
	 To support various features like header value parsing and retrieval
	 HTTP client needs to keep the entire HTTP header in a single
	 contiguous buffer. This configuration selects the size of this
	 buffer. The default value has been found to be sufficient. If your
	 particular app needs more or less it can be adjusted accordingly.

config ENABLE_HTTPC_SECURE
       prompt "Enable HTTPS support in HTTP client (over port 443)"
       bool
       depends on ENABLE_TLS
       default n

config ENABLE_HTTPC_MODIFY_TIME
       prompt "Enable the use of \"modify_time\" field in HTTP header in HTTP client"
       bool
       default n
       help
	 Select this option if you need to access the "modify_time" field of HTTP header of the
	 HTTP response packet. Enabling this option would result in increase of approximately
	 1500 bytes of footprint.

endmenu
```

## hiku_gen3/marvell/wmsdk_bundle-3.3.33/sdk/src/middleware/httpd/Kconfig
```kconfig
menu "HTTP Server (HTTPD)"
config ENABLE_HTTP_SERVER
       prompt "Enable HTTP support (port 80)"
       bool
       default y

config ENABLE_HTTPS_SERVER
       prompt "Enable HTTPS support (port 443)"
       bool
       depends on ENABLE_TLS
       default n

config HTTP_CLIENT_SOCKETS
       int "Max simultaneous active HTTP client sockets"
       range 1 10
       default 1
       help
                HTTP Server generally accepts a single client connection,
		 finishes all activities on it, closes the socket and
		 then handles further requests.
		 However, there may be a need to handle new connections
		 without closing earlier ones.
		 This configuration defines the maximum number of such
		 simultaneous active client connections that the HTTP
		 Server can handle.

config ENABLE_HTTPD_STATS
       bool
       default y
       help
		This is a hidden configuration to enable HTTPD stats
		collection. Can be brought out to menu later when
		required. It is kept default enabled as it was always
		enabled before this configuration was added.

config ENABLE_HTTPD_KEEPALIVE
	bool
	prompt "Enable Keep Alive mechanism for connections"
	default y
	help
		Keep Alive is used by the HTTPD server to check if the
		client is active. If the client has gone offline without
		closing the socket, the keep alive mechanism will detect
		this and close the socket after appropriate time.
		Enabling this is recommended. However, when this is enabled,
		the client cannot go into sleep for longer durations.

config ENABLE_HTTPD_PURGE_LRU
	bool
	prompt "Enable LRU based client socket purge"
	default n
	help
		If this is enabled, in order to serve new client requests,
		the webserver will terminate the least recently used (LRU)
		connection if there is no room for accepting a new request.
		The maximum possible connections are governed by
		CONFIG_HTTP_CLIENT_SOCKETS

endmenu
```

## hiku_gen3/marvell/wmsdk_bundle-3.3.33/sdk/src/middleware/provisioning/Kconfig
```kconfig
menu "PROVISIONING"

config ENABLE_SCAN
       bool "Scan Support"
       def_bool y
       help
         This option enables the use of scan support.
endmenu
```

## hiku_gen3/marvell/wmsdk_bundle-3.3.33/sdk/src/middleware/tls/Kconfig
```kconfig
menu "TLS"

config ENABLE_TLS
       bool "Enable TLS Library (CyaSSL)"
       def_bool y
       help
         This option enables the TLS.
       depends on OS_FREERTOS && LWIP_STACK

config ENABLE_CYASSL_DEBUG
       bool "Enable CyaSSL debug"
       default n

if ENABLE_CYASSL_DEBUG
menu "CyaSSL debug options"

config CYASSL_ENABLE_ERROR_LOG
       bool "Enable Error logs"
       default y
       help
		This option enables error logs
		from the CyaSSL library. Note that this
		increases the static footprint of the
		generated binary.

config CYASSL_ENABLE_INFO_LOG
       bool "Enable info logs"
       default n
       help
		This option enables info logs
		from the CyaSSL library. Note that this
		increases the static footprint of the
		generated binary.

config CYASSL_ENABLE_FUNC_ENTRY_LOG
       bool "Enable function entry logs"
       default n
       help
		This option enables function
		entry logs from the CyaSSL library. Note
		that this increases the static footprint
		of the generated binary.

config CYASSL_ENABLE_FUNC_LEAVE_LOG
       bool "Enable function leave logs"
       default n
       help
		This option enables function
		leave logs from the CyaSSL library. Note
		that this increases the static footprint
		of the generated binary.

config CYASSL_ENABLE_OTHER_LOG
       bool "Enable other logs"
       default n
       help
		This option enables other logs
		from the CyaSSL library. Note that this
		increases the static footprint of the
		generated binary.

endmenu
endif
endmenu
```

## hiku_gen3/marvell/wmsdk_bundle-3.3.33/sdk/src/platform/net/Kconfig
```kconfig
menu "TCP/IP"

menu "TCP/IP stack"
config MAX_SOCKETS_TCP
	int "Max simultaneous active TCP sockets"
	range 1 32
	default 8
	help
	 This number represents maximum number of simultaneous
	 active TCP sockets.
	 These sockets would be consumed by both TCP server and
	 TCP client applications running on the device.

	 Typical users of these sockets are:
	 a) Client sockets created by httpd module, which are
	 represented by CONFIG_HTTP_CLIENT_SOCKETS
	 b) Sockets used in httpc module.
	 Client sockets of httpd represents the subset of
	 TCP sockets, hence value of MAX_SOCKETS_TCP should
	 always be greater than CONFIG_HTTP_CLIENT_SOCKETS.

	 Footprint impact:
	 Each of these sockets takes up approximately 3244 bytes of RAM.
	 84 + 2 (default value for CONFIG_TCP_SND_BUF_COUNT) * 1580

	 Please note the difference between this configuration
	 and MAX_LISTENING_SOCKETS_TCP.

config MAX_LISTENING_SOCKETS_TCP
	int "Max simultaneous active TCP listening sockets"
	range 1 16
	default 4
	help
	 This number represents maximum number of simultaneous
	 active TCP sockets in LISTEN mode.
	 These sockets would be consumed by only TCP server
	 applications running on the device.

	 Typical user of listening socket is httpd module, which
	 consumes 2 listening sockets, one for IPv4 & one for IPv6.
	 Set the value of this option accordingly.

	 Footprint impact:
	 Each of these sockets takes up approximately 84 bytes of RAM.

	 Please note the difference between this configuration
	 and MAX_SOCKETS_TCP.

config MAX_SOCKETS_UDP
	int "Max simultaneous active UDP sockets"
	range 1 32
	default 6
	help
	 This number represents maximum number of simultaneous
	 active UDP sockets.
	 These sockets would be consumed by UDP server and
	 UDP client applications running on the device.

	 Typical user of UDP socket is mDNS module, which
	 consumes 3 UDP sockets, one for IPv4, one for IPv6
	 and one for internal communication.
	 Set the value of this option accordingly.

	 Footprint impact:
	 Each of these sockets takes up approximately 1580 bytes of RAM.

config TCP_SND_BUF_COUNT
	int "Max number of TCP Send buffers per socket"
	range 1 8
	default 2
	help
	 This number represents maximum number of TCP send buffers
	 allocated per socket.
	 Size of each buffer is 1580 bytes. Hence applications will
	 get (1580 * CONFIG_TCP_SND_BUF_COUNT) bytes of buffer space
	 for TCP communication.

	 Footprint impact:
	 Increase by 1 in this value would increase the RAM usage by
	 (1580 * CONFIG_MAX_SOCKETS_TCP) bytes

	 Please note that this is a advanced configuration option.
	 Default value of 2 is suitable for common use cases.
	 Please change the default value of the parameter only if you
	 know the implications.

config TCPIP_STACK_TX_HEAP_SIZE
	int "TCP/IP Stack Transmit Heap size (in KiloBytes)"
	range 0 64
	default 0
	help
	 This number represents maximum size of TCP/IP stack Heap
	 (in KiloBytes), which is used for packets getting transmitted out of
	 the device. Note that this heap space is located in RAM.

	 By default, the value of this Heap size is determined by the values of
	 various CONFIG options including: CONFIG_MAX_SOCKETS_TCP,
	 CONFIG_MAX_LISTENING_SOCKETS_TCP, CONFIG_MAX_SOCKETS_UDP and
	 CONFIG_TCP_SND_BUF_COUNT.
	 Please refer to the help text of these CONFIG options to understand the
	 impact of each option on the RAM usage.
	 The value of this CONFIG option will be used only if it is non-zero,
	 else the heap size is calculated using the above method.
endmenu

endmenu
```
